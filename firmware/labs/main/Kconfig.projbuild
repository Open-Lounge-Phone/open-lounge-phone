## firmware/labs/main/Kconfig.projbuild
```kconfig
# The phone's options (shared), then the labs ones.
rsource "../../main/Kconfig.projbuild"

menu "Open Lounge Phone labs"
config OLP_LABS
    bool "Labs features (house intercom, check-in, macro pad, home panel, stories, doorbell)"
    default y
    help
        Only in the labs project (firmware/labs). The phone firmware never has this set.
endmenu
```

## firmware/main/Kconfig.projbuild
```kconfig
menu "Open Lounge Phone"

choice OLP_BOARD
    prompt "Board"
    default OLP_BOARD_REVA
    help
        The board this firmware is for: it decides which pins are in use and the board id that
        updates must be signed for (an update for one board never installs on another).
        README "Building for each board".

config OLP_BOARD_REVA
    bool "Minimal board rev A (hw v0.1): Wi-Fi"
    help
        The board that exists today. GPIO0 is only the BOOT button and GPIO45 is free: this
        build never drives them and has no wired network code. Board id minimal-revA.

config OLP_BOARD_V0901
    bool "hw v0.901: rev A + RJ45 (W5500 wired network) and PoE"
    select ETH_USE_SPI_ETHERNET if !OLP_QEMU
    select ETH_SPI_ETHERNET_W5500 if !OLP_QEMU
    help
        The RJ45 revision: a W5500 on the display's SPI bus (CS on GPIO0, MISO on GPIO45),
        polled. With a cable that has a link and an address the phone uses it and turns Wi-Fi
        off; without, it falls back to Wi-Fi. Board id minimal-v0901. In a QEMU build, QEMU's
        Ethernet stands in for the W5500 (the cable), so the network choice runs in the
        simulator.

endchoice

config OLP_UI_V2
    bool "Framed screens (title bar, rules, separators)"
    default n
    help
        A personal look: status screens draw a frame and a rule under the main line; menus and
        setup screens get a black title bar and dotted separators. Off = docs/phone-ux.md.

config OLP_EPD_213
    bool "Display: WeAct 2.13\" e-paper (250 x 122); off = the 2.9\" (296 x 128)"
    default y
    help
        The 2.13" module plugs into the same 2x4 socket (same controller and pin order); its panel
        is smaller. Text is drawn smaller to fit (docs/phone-ux.md).

config OLP_SERVER_URL
    string "Server (WebSocket base URL; empty = none, chosen on the setup page)"
    default ""
    help
        Base URL of the Open Lounge Phone server; the phone connects to <url>/ws/device.
        Empty (the default): the phone connects to nothing until someone chooses a server on the
        setup page (your own, or the public hub to try it), with MENU -> 4 or the console
        `server` command (both stored in NVS). Set it to bake your own server into your builds.

config OLP_WIFI_SSID
    string "Default Wi-Fi SSID"
    default ""
    help
        Used when no Wi-Fi is stored in NVS (console: `wifi <ssid> <pass>`).

config OLP_WIFI_PASSWORD
    string "Default Wi-Fi password"
    default ""

config OLP_SIM
    bool "Build for a simulator (Wokwi or QEMU)"
    default n
    help
        Moves keys 6 and 7 off the UART0 pins (the simulator's console) and uses the test audio
        device (no ES8311 in a simulator).

config OLP_QEMU
    bool "Build for QEMU (Espressif's esp32s3 machine)"
    depends on OLP_SIM
    default n
    select ETH_USE_OPENETH
    help
        QEMU has no Wi-Fi: the network is its emulated OpenCores Ethernet (user-mode NAT, see
        tools/qemu.sh). There is no display either: the framebuffer is kept for `screen`.

config OLP_STORAGE_ENCRYPTED
    bool "Encrypt NVS (device key, Wi-Fi) with the eFuse HMAC key: release builds"
    default n
    select NVS_ENCRYPTION
    help
        ESP-IDF's HMAC-based NVS encryption (no flash encryption needed). ON in release builds
        (sdkconfig.release, which also sets NVS_SEC_HMAC_EFUSE_KEY_ID=5), OFF for development and
        the simulators. The first boot with it BURNS a random key into eFuse KEY5: one-time and
        irreversible (README "Encrypted storage").

menu "Updates (OTA)"

config OLP_BOARD_ID
    string
    default "minimal-v0901" if OLP_BOARD_V0901
    default "minimal-revA"
    help
        The board this firmware runs on, from the board choice (no prompt: it can't be set by
        hand, so a build for one board never carries another's id). minimal-revA = hw v0.1 (the
        minimal board, rev A), minimal-v0901 = hw v0.901 (RJ45 + PoE). A signed manifest for
        another board is refused.

config OLP_OTA
    bool "Firmware updates over the air (needs your own update key)"
    default n
    help
        Off by default: a phone built from source never checks for updates. Turn it on to update
        your phones from your own channel: `tools/release.sh keygen` makes your key pair in
        keys/ (gitignored), and the manifest URL below (or `ota url`) says where to look.
        Official release builds (sdkconfig.release) turn it on with the project's release key
        and channel. README "Your keys, your server".

config OLP_OTA_MANIFEST_URL
    string "Firmware update channel (manifest URL; empty = set later with `ota url`)"
    depends on OLP_OTA
    default ""
    help
        A fixed URL whose signed manifest names the newest firmware, e.g. your fork's
        https://github.com/<you>/<repo>/releases/download/fw-stable/firmware-manifest.json
        (tools/release.sh publish --repo <you>/<repo> keeps it current). Never /releases/latest:
        that is whatever release is newest, a hardware release (hw-v*) included. The console
        `ota url <url>` overrides it (NVS).

config OLP_OTA_PUBKEY
    string "Update public key (PEM, relative to firmware/)"
    depends on OLP_OTA
    default "keys/ota_signing_pub.pem"
    help
        The key whose signature a manifest must carry (RSA-3072, RSA-PSS/SHA-256; the same key
        signs release images). `tools/release.sh keygen` writes yours here. Official release
        builds use the project's key, main/ota_signing_pub.pem. The build stops if the file is
        missing.

config OLP_OTA_NIGHT_ONLY
    bool "Install automatic updates only at night (02:00-05:00 local)"
    depends on OLP_OTA
    default y
    help
        Updates install only while the phone is hung up and idle (10 min) either way. Local time
        comes from SNTP and the space's UTC offset in `config`. MENU -> 9 installs at once.

config OLP_TEST_CRASH_AT_BOOT
    bool "TEST ONLY: crash at boot (the OTA rollback test's broken image)"
    default n

endmenu

menu "Call audio"

config OLP_EARPIECE_MAX_DB
    int "Earpiece volume cap (dBFS)"
    range -30 0
    default -6
    help
        The loudest the earpiece plays (volume 10/10). Full scale reaches about 98 dB SPL with
        the assumed receiver (hardware/SCHEMATIC_REVIEW.md, owner question 8), so the default
        cap is -6 dBFS until the handset's receiver is measured. Each volume step is 3 dB.

config OLP_MIC_PGA_DB
    int "Handset mic PGA gain (dB, 0-30 in 3 dB steps)"
    range 0 30
    default 30
    help
        ES8311 analog PGA gain for the handset electret: the fixed analog gain, set high enough
        for a quiet handset without clipping a loud one. On the first board speech peaked around
        -38 dBFS at 18 dB, so the default is the PGA's top (30 dB) plus OLP_MIC_SCALE_DB; the
        AGC does the rest. To be confirmed on a board with `audio gain` and the phone check
        (docs/audio.md).

config OLP_MIC_SCALE_DB
    int "Handset mic ADC digital scale-up (dB, 0-42 in 6 dB steps)"
    range 0 42
    default 6
    help
        The ES8311 ADC's digital gain after the PGA (register 0x16).

config OLP_CALL_OPUS
    bool "Opus wideband calls (16 kHz), PCMU as the fallback"
    default y
    help
        The phone offers and accepts Opus (16 kHz mono, about 24 kbit/s, in-band FEC) and PCMU.
        Off: PCMU (8 kHz G.711) only, as firmware up to 0.9.5.

config OLP_AUDIO_BLOCK
    int "Codec DMA block (samples at 16 kHz)"
    range 16 320
    default 16
    help
        The I2S DMA block the audio pump reads and writes: 16 = 1 ms. The sidetone is mixed
        between a block in and the blocks queued out (three DMA buffers), so its delay is about
        3 blocks plus the codec's filters: under 5 ms with 1 ms blocks.

config OLP_ECHO_CANCEL
    bool "Echo canceller on by default"
    default n
    help
        SpeexDSP's echo canceller (64 ms tail) and residual echo suppressor on the handset mic.
        Off by default until the reference handsets' echo is measured (docs/audio.md item 5):
        each phone can turn it on (MENU 1 7), and the phone check's echo test turns it on
        when it measures a poor echo loss. The echo is measured in every call either way.

config OLP_MIC_AGC
    bool "Automatic gain control on the handset mic"
    default y
    help
        A slow digital AGC after the ADC: speech to about -24 dBFS (gain -6 to +18 dB), only
        following frames that look like speech, with a peak limiter at -3 dBFS. `audio agc
        on|off` on the console.

config OLP_AUDIO_TEST_DEVICE
    bool "Use the test audio device (1 kHz source, analysing sink) instead of the ES8311"
    default y if OLP_SIM
    default n
    help
        The simulator has no ES8311. On a board without a codec the firmware falls back to the
        test device anyway.

config OLP_ICE_TCP_RELAY
    bool "TURN over TCP/TLS as well as UDP (experimental: broken in esp_peer 1.5.6)"
    default n
    help
        esp_peer uses one TURN server over UDP and one over TCP or TLS. In esp_peer 1.5.6 the
        TCP/TLS relay doesn't work (TLS gives up before the TCP connect finishes; over TCP, ICE
        pairs but DTLS reads fail) and listing it stalls candidate gathering, so calls use STUN +
        TURN over UDP only. Turn this on to try a newer esp_peer. `ice tcp` / `ice tls` on the
        console try it for the next call.

config OLP_ICE_PREFER_TLS
    bool "With the TCP/TLS relay: prefer TURN over TLS on port 443"
    depends on OLP_ICE_TCP_RELAY
    default y

config OLP_RTC_AGENT_TIMEOUT_MS
    int "ICE agent receive timeout (ms)"
    default 300 if OLP_SIM
    default 100

config OLP_RTC_TASK_STACK
    int "WebRTC task stack (bytes)"
    default 16384

endmenu

endmenu
```
